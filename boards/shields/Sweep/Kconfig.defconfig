## boards/shields/Sweep/Kconfig.defconfig
```kconfig
# Copyright (c) 2020 The ZMK Contributors
# SPDX-License-Identifier: MIT

if SHIELD_SWEEP_CENTRAL_DONGLE || SHIELD_SWEEP_CENTRAL_LEFT

config ZMK_KEYBOARD_NAME
    default "Sweep"

config ZMK_SPLIT_ROLE_CENTRAL
    default y

endif

if SHIELD_SWEEP_CENTRAL_DONGLE || SHIELD_SWEEP_CENTRAL_LEFT || SHIELD_SWEEP_PERIPHERAL_LEFT || SHIELD_SWEEP_PERIPHERAL_RIGHT

config ZMK_SPLIT
    default y

endif
```

## boards/shields/cradio/Kconfig.shield
```kconfig
# No whitespace after the comma or in the keyboard name!
config SHIELD_CRADIO_DONGLE
    def_bool $(shields_list_contains,cradio_dongle)
```

## config/boards/shields/cradio/Kconfig.defconfig
```kconfig
# Copyright (c) 2020 The ZMK Contributors
# SPDX-License-Identifier: MIT

if SHIELD_SWEEP_PRO_DONGLE

config ZMK_KEYBOARD_NAME
	default "SWEEP_PRO Dongle"
	
config ZMK_SPLIT_BLE_ROLE_CENTRAL
	default y
	
config ZMK_USB
	default y

endif

if SHIELD_SWEEP_PRO_LEFT || SHIELD_SWEEP_PRO_RIGHT || SHIELD_SWEEP_PRO_DONGLE 

config ZMK_SPLIT
	default y

config ZMK_BLE
	default y
	
endif
```

## config/boards/shields/cradio/Kconfig.shield
```kconfig
# Copyright (c) 2020 The ZMK Contributors
# SPDX-License-Identifier: MIT

config SHIELD_CRADIO_LEFT
    def_bool $(shields_list_contains,cradio_left)

config SHIELD_CRADIO_RIGHT
    def_bool $(shields_list_contains,cradio_right)

# No whitespace after the comma or in the keyboard name!
config SHIELD_CRADIO_DONGLE
    def_bool $(shields_list_contains,cradio_dongle)
```

## config/west.yml
```yaml
manifest:
  remotes:
    - name: zmkfirmware
      url-base: https://github.com/zmkfirmware
    # Additional modules containing boards/shields/custom code can be listed here as well
    # See https://docs.zephyrproject.org/3.2.0/develop/west/manifest.html#projects
    - name: sweep-pro-shield-module
      url-base: https://github.com/sky-bro
    - name: zmk
      url-base: https://github.com/sky-bro
    - name: englmaxi
      url-base: https://github.com/englmaxi
  projects:
    # - name: zmk
    #   remote: zmkfirmware
    #   revision: main
    #   import: app/west.yml
    - name: zmk
      remote: zmk
      revision: k4i-sweep-kbd
      import: app/west.yml
    - name: sweep-pro-shield-module
      remote: sweep-pro-shield-module
      revision: main
    - name: zmk-dongle-display
      remote: englmaxi
      revision: main
  self:
    path: config
```
